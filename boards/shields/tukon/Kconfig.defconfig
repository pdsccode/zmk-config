## boards/shields/tukon/Kconfig.defconfig
```kconfig
# This file sets the the board specific configuration
# see https://docs.zephyrproject.org/latest/build/kconfig/setting.html#initial-conf

if SHIELD_TUKON_LEFT

config ZMK_KEYBOARD_NAME
    default "Tukon"

config ZMK_SPLIT_ROLE_CENTRAL
    default y

endif # SHIELD_TUKON_LEFT

if SHIELD_TUKON_LEFT || SHIELD_TUKON_RIGHT

config ZMK_SPLIT
    default y

config TUKON_PM
    bool "Tukon Automatic Power Management"
    default y
    select ZMK_POWER_DOMAINS
    select ZMK_POWER_DOMAINS_DYNAMIC_DEFAULT
    select PM_DEVICE
    select PM_DEVICE_POWER_DOMAIN
    select PM_DEVICE_RUNTIME
    select POWER_DOMAIN
    select POWER_DOMAIN_GPIO

config TUKON_RGB_UNDERGLOW
    bool "Tukon per Key RGB LEDs"
    default y
    select ZMK_RGB_UNDERGLOW
    select WS2812_STRIP
    select SPI
    select ZMK_RGB_UNDERGLOW_AUTO_OFF_IDLE
    select ZMK_RGB_UNDERGLOW_AUTO_OFF_USB

config TUKON_DISPLAY
    bool "Tukon OLED Display"
    default y
    select ZMK_DISPLAY
    select I2C
    select SSD1306


if LVGL

config LV_Z_VDB_SIZE
    default 64

config LV_DPI_DEF
    default 148

config LV_Z_BITS_PER_PIXEL
    default 1

choice LV_COLOR_DEPTH
    default LV_COLOR_DEPTH_1
endchoice

endif # LVGL

    
endif # SHIELD_TUKON_LEFT || SHIELD_TUKON_RIGHT
```

## boards/shields/tukon/Kconfig.shield
```kconfig
# Define shield specific symbols (configuration options/ what i would
# call "configuration variables")

config SHIELD_TUKON_LEFT
    def_bool $(shields_list_contains,tukon_left)

config SHIELD_TUKON_RIGHT
    def_bool $(shields_list_contains,tukon_right)

# ---
# Note to self:
# def_bool X > 2
# is the same as 
# bool
# default X > 2
# see https://docs.zephyrproject.org/latest/build/kconfig/tips.html
```
